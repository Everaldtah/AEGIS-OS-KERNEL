## kernel/configs/aegis_defconfig
```kconfig
# AEGIS-OS Kernel Configuration
# Based on Linux 6.x LTS with security hardening

# Security Frameworks
CONFIG_SECURITY=y
CONFIG_SECURITY_NETWORK=y
CONFIG_SECURITY_PATH=y
CONFIG_LSM="lockdown,yama,landlock,sentinel,apparmor,bpf"

# Seccomp
CONFIG_SECCOMP=y
CONFIG_SECCOMP_FILTER=y
CONFIG_HAVE_ARCH_SECCOMP_FILTER=y

# Landlock (sandboxing)
CONFIG_SECURITY_LANDLOCK=y

# AppArmor (optional, can be disabled)
CONFIG_SECURITY_APPARMOR=y
CONFIG_DEFAULT_SECURITY_APPARMOR=y

# Memory Protection
CONFIG_RANDOMIZE_BASE=y
CONFIG_RANDOMIZE_MEMORY=y
CONFIG_RANDOMIZE_KSTACK_OFFSET=y
CONFIG_ASLR=y
CONFIG_HARDENED_USERCOPY=y
CONFIG_HARDENED_USERCOPY_FALLBACK=y
CONFIG_FORTIFY_SOURCE=y
CONFIG_STACKPROTECTOR=y
CONFIG_STACKPROTECTOR_STRONG=y
CONFIG_CC_STACKPROTECTION=y
CONFIG_VMAP_STACK=y
CONFIG_SCHED_STACK_END_CHECK=y
CONFIG_DEBUG_WX=y
CONFIG_DEBUG_RODATA=y
CONFIG_STRICT_KERNEL_RWX=y
CONFIG_STRICT_MODULE_RWX=y

# Control Flow Integrity
CONFIG_CC_HAVE_STACKPROTECTOR=y
CONFIG_CC_HAVE_INLINE_YIELD=y

# Module signing
CONFIG_MODULE_SIG=y
CONFIG_MODULE_SIG_FORCE=y
CONFIG_MODULE_SIG_ALL=y
CONFIG_MODULE_SIG_SHA256=y
CONFIG_MODULE_SIG_HASH="sha256"

# IMA/EVM (Integrity Measurement Architecture)
CONFIG_INTEGRITY=y
CONFIG_IMA=y
CONFIG_IMA_SYMLINK_MOD=y
CONFIG_IMA_APPRAISE=y
CONFIG_IMA_TRUSTED_KEYRING=y
CONFIG_EVM=y

# Address Space Layout Randomization
CONFIG_RELOCATABLE=y
CONFIG_RANDOMIZE_MEMORY=y

# Ref Counting hardening
CONFIG_REFCOUNT_FULL=y

# Hardened memory allocation
CONFIG_SLAB_HARDENED=y
CONFIG_SLUB_DEBUG=y
CONFIG_SLUB_DEBUG_ON=y

# RCU hardening
CONFIG_RCU_STRICT_GRACE_PERIOD=y

# Audit
CONFIG_AUDIT=y
CONFIG_AUDITSYSCALL=y
CONFIG_AUDIT_WATCH=y
CONFIG_AUDIT_TREE=y

# Networking security
CONFIG_NETFILTER=y
CONFIG_NETFILTER_ADVANCED=y
CONFIG_NETFILTER_NETLINK=y
CONFIG_NETFILTER_NETLINK_ACCT=y
CONFIG_NETFILTER_NETLINK_QUEUE=y
CONFIG_NETFILTER_NETLINK_LOG=y
CONFIG_NF_CONNTRACK=y
CONFIG_NF_LOG_SYSLOG=y
CONFIG_NF_TABLES=y
CONFIG_NFT_COMPAT=y

# ForensicFS - Required filesystems
CONFIG_OVERLAY_FS=y
CONFIG_OVERLAY_FS_REDIRECT_DIR=y
CONFIG_SQUASHFS=y
CONFIG_SQUASHFS_ZLIB=y
CONFIG_SQUASHFS_LZ4=y
CONFIG_SQUASHFS_XZ=y
CONFIG_SQUASHFS_ZSTD=y
CONFIG_DM_VERITY=y
CONFIG_DM_VERITY_FEC=y
CONFIG_DM_VERITY_AVB_VERIFICATION=y

# Debugging (for development)
CONFIG_DEBUG_KERNEL=y
CONFIG_DEBUG_INFO=y
CONFIG_KGDB=y
CONFIG_KPROBES=y
CONFIG_FTRACE=y
CONFIG_FUNCTION_TRACER=y
CONFIG_STACKTRACE=y
CONFIG_DEBUG_LIST=y
CONFIG_DEBUG_PLIST=y
CONFIG_DEBUG_CREDENTIALS=y

# Performance
CONFIG_PM=y
CONFIG_ACPI=y
CONFIG_CPU_FREQ=y

# Essential hardware support
CONFIG_PCI=y
CONFIG_ATA=y
CONFIG_SATA_AHCI=y
CONFIG_USB=y
CONFIG_USB_STORAGE=y
CONFIG_NET_CORE=y
CONFIG_NETDEVICES=y
CONFIG_E1000=y
CONFIG_VIRTIO_NET=y

# Filesystems
CONFIG_EXT4_FS=y
CONFIG_EXT4_FS_POSIX_ACL=y
CONFIG_EXT4_FS_SECURITY=y
CONFIG_BTRFS_FS=y
CONFIG_XFS_FS=y
CONFIG_PROC_FS=y
CONFIG_PROC_SYSCTL=y
CONFIG_SYSFS=y
CONFIG_TMPFS=y
CONFIG_TMPFS_POSIX_ACL=y
CONFIG_DEVTMPFS=y
CONFIG_DEVTMPFS_MOUNT=y

# Kernel compression
CONFIG_KERNEL_XZ=y

# System V IPC
CONFIG_SYSVIPC=y
CONFIG_POSIX_MQUEUE=y

# Enable print for early debugging
CONFIG_PRINTK=y
CONFIG_PRINTK_TIME=y
CONFIG_DYNAMIC_DEBUG=y

# Core kernel features
CONFIG_HOTPLUG=y
CONFIG_SMP=y
CONFIG_SMP_LOCK=y
```
